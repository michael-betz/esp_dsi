/*
 * ----------------------------------------------------------------------------
 * "THE BEER-WARE LICENSE" (Revision 42):
 * Jeroen Domburg <jeroen@spritesmods.com> wrote this file. As long as you retain
 * this notice you can do whatever you want with this stuff. If we meet some day,
 * and you think this stuff is worth it, you can buy me a beer in return.
 * ----------------------------------------------------------------------------
 */
#include <stdio.h>
#include <alloca.h>
#include <stdlib.h>
#include <string.h>
#include "freertos/FreeRTOS.h"
#include "freertos/task.h"
#include "spi_dsi.h"


typedef struct {
	uint8_t type;
	uint8_t addr;
	uint8_t len;
	uint8_t data[16];
} DispPacket;

//Copied from the X163QLN01 application note.
static const DispPacket initPackets[]={
	{0x39, 0xF0, 5, {0x55, 0xAA, 0x52, 0x08, 0x00}},
	{0x39, 0xBD, 5, {0x01, 0x90, 0x14, 0x14, 0x00}},
	{0x39, 0xBE, 5, {0x01, 0x90, 0x14, 0x14, 0x01}},
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	{0x15, 0x3A, 1, {0x55}}, //16-bit mode
//	{0x29, 0x2B, 4, {0x00, 0x00, 0x00, 0xEF}},
	{0,0,0,{0}}
};

void initOled() {
	for (int i=0; initPackets[i].type!=0; i++) {
		if (initPackets[i].type==0x39 || initPackets[i].type==0x29) {
			uint8_t data[17];
			data[0] = initPackets[i].addr;
			memcpy(data + 1, initPackets[i].data, 16);
			mipiDsiSendLong(initPackets[i].type, data, initPackets[i].len + 1);
		} else {
			uint8_t data[2] = {initPackets[i].addr, initPackets[i].data[0]};
			mipiDsiSendShort(initPackets[i].type, data, initPackets[i].len + 1);
			if (initPackets[i].type == 5)
				vTaskDelay(300 / portTICK_PERIOD_MS);
		}
	}

	uint8_t clrData[33] = {0x2c, 0, 0, 0};
	for (int i=0; i < (320*340*2) / 32; i++) {
		mipiDsiSendLong(0x39, clrData, 32);
		clrData[0] = 0x3C;
	}
	printf("Display inited.\n");
}
